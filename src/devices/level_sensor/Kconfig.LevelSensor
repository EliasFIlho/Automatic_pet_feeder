## src/devices/level_sensor/Kconfig.LevelSensor
```kconfig
menu "Level Sensor Options"

config LEVEL_ALERT_PERCENT
    int "Percent value to emit a food level alert"
    default 25


config LEVEL_SENSOR_THREAD_STACK_SIZE
    int "Define Level Sensor thread stack size"
    default 1024

config LEVEL_SENSOR_THREAD_PRIORITY
    int "Define Level Sensor thread priority"
    default 5

config LEVEL_SENSOR_THREAD_PERIOD
    int "Define the period in ms of the Level Sensor thread"
    default 10000

endmenu
```

## src/devices/rtc/Kconfig.RTC
```kconfig
menu "RTC options"

config SNTP_TRY_COUNT 
    int "Retry count for SNTP sync"
    default 5

config SNTP_HOST
    string "SNTP Server Address"
    default "a.st1.ntp.br"

config RTC_SYNC_TIME
    int "Sync period in seconds to avoid shiffted time"
    default "3600"

config SNTP_REQUEST_TIMOUT
    int "Max time to wait for SNTP request in miliseconds"
    default 4000

config TIME_ZONE_VALUE
    int "Value to complement the UTC in miliseconds"
    default 10800

config TIME_ZONE_OPERATION
    bool "if true time zone will be UTC - CONFIG_TIME_ZONE_VALUE, if false UTC + CONFIG_TIME_ZONE_VALUE"
    default y

config RTC_BASE_YEAR
    int "Start year for RTC"
    default 1900
endmenu
```

## src/network/Kconfig.Network
```kconfig
menu "Network service options"

config RSSI_WORK_PERIOD
    int "Period for RSSI work in seconds"
    default 10

config RSSI_LOWER_VALUE
    int "Lower value to RSSI for map function"
    default -90

config RSSI_HIGHER_VALUE
    int "Higher value to RSSI for map function"
    default -30
config NETWORK_DISPATCH_THREAD_STACK_SIZE
    int "Stack size for network dispatch thread"
    default 3048
config NETWORK_DISPATCH_THREAD_PRIORITY
    int "Network evt dispatch thread priority"
    default 5

config NETWORK_CONNECTION_MAX_TRIES
    int "Max tries that will be allowed to network to connect/reconnect"
    default 10
endmenu
```

## src/network/http/client/Kconfig.HttpClient
```kconfig
menu "HTTP options"

config HTTPS_THREAD_STACK_SIZE
    int "Define https thread stack size"
    default 8000

config HTTPS_THREAD_PRIORITY
    int "Define https thread priority"
    default 5

config HTTPS_THREAD_PERIOD
    int "Define the period in ms of te https thread"
    default 5000

config HTTP_VERSION
    bool "Enable application to use mocked functions"
    default y

config HTTPS_REQUEST_PORT
    string "HTTPS port to be used with secure sockets"
    default "8080"


config HTTPS_REQUEST_ADDRESS
    string "HTTP/HTTPS server address"
    default "192.168.100.22"

config HTTPS_REQUEST_URL
    string "HTTP/HTTPS server URL"
    default "/get_rules"

config HTTPS_REQUEST_TIMEOUT
    int "HTTP/HTTPS request timeout"
    default 3000

config HTTP_RECV_BUF_LEN
    int "HTTP/HTTPS request timeout"
    default 512

endmenu
```

## src/network/mqtt/Kconfig.MQTT
```kconfig
menu "MQTT options"

config DEVICE_ID
    string "Device name id"
    default "DEV-X"

config MQTT_DEVICE_LOGIN
    string "Device login in MQTT broker"
    default "pet_feeder"

config MQTT_DEVICE_PASSWORD
    string "Device password in MQTT broker"
    default "@D07gbb2as2"


config MQTT_PROTOCOL_VERSION
    int "Protocol version for MQTT"
    default 4

config MQTT_TRANSPORT_TYPE
    int "MQTT transport layer"
    default 0

config MQTT_BROKER_ADDR
    string "Broker address"
    default "192.168.100.31"

config MQTT_BROKER_PORT
    int "Broker port"
    default 1883

config MQTT_RX_BUFFER_SIZE
    int "Rx Buffer size for MQTT"
    default 1024

config MQTT_TX_BUFFER_SIZE
    int "Tx Buffer size for MQTT"
    default 1024

config MQTT_RULES_TOPIC
    string "MQTT Topic path"
    default "device/rules"

config MQTT_SENSOR_TOPIC
    string "MQTT Sensor Topic path"
    default "device/sensor/level"


config MQTT_THREAD_STACK_SIZE
    int "Define MQTT thread stack size"
    default 4096

config MQTT_THREAD_PRIORITY
    int "Define MQTT thread priority"
    default 5

config MQTT_THREAD_PERIOD
    int "Define the period in ms of te MQTT thread"
    default 5000

config MQTT_THREAD_RECONNECT_PERIOD
    int "Define the period in ms for MQTT reconnect"
    default 5000

config NUM_OF_TOPICS
    int "Number of topics"
    default 2

config MQTT_WATCHDOG_TIMEOUT_THREAD
    int "Timout in miliseconds for trigger watchdog for Read Payload thread"
    default 31000

config MQTT_PUBLISH_BUFFER_SIZE
    int "Publish buffer size"
    default 100


endmenu
```

## src/network/wifi/Kconfig.Wifi
```kconfig
menu "WIFI options"

config WIFI_CONNECT_TIMEOUT
    int "Set timeout for connection request in seconds"
    default 30

config WIFI_GET_IP_TIMEOUT
    int "Set timeout for DHCP request in seconds"
    default 30

config WIFI_PSK_BUF_LEN
    int "Wifi psk buffer len"
    default 32

config WIFI_SSID_BUF_LEN
    int "Wifi SSID buffer len"
    default 32
config WIFI_AP_SSID
    string "AP SSID Displayed name"
    default "Pet-Feeder"
config WIFI_AP_PSK
    string "AP PSK used to connect"
    default "12345678"

config WIFI_AP_MASK
    string "Network mask for AP mode"
    default "255.255.255.0"
config WIFI_AP_IP
    string "Network IP for AP mode"
    default "192.168.100.1"

endmenu
```
